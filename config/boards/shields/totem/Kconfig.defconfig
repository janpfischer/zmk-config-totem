## config/boards/shields/totem/Kconfig.defconfig
```kconfig
# Copyright (c) 2022 The ZMK Contributors
# SPDX-License-Identifier: MIT

if SHIELD_TOTEM_LEFT

config ZMK_KEYBOARD_NAME
    default "TOTEM"
    
config ZMK_SPLIT_ROLE_CENTRAL
    default y

endif

if SHIELD_TOTEM_LEFT || SHIELD_TOTEM_RIGHT

config ZMK_SPLIT
    default y

endif

if SHIELD_TOTEM_DONGLE

# Max 16 characters in keyboard name
config ZMK_KEYBOARD_NAME
    default "TOTEM DONGLE"

config ZMK_SPLIT_ROLE_CENTRAL
    default y

config ZMK_SPLIT
    default y

# Set this to the number of peripherals your dongle will have.
# For a unibody, this would be 1. If you have left and right halves, set it to 2, etc.
config ZMK_SPLIT_BLE_CENTRAL_PERIPHERALS
    default 2 

# Set this to ZMK_SPLIT_BLE_CENTRAL_PERIPHERALS + your desired number of BT profiles (default is 5)
config BT_MAX_CONN
    default 6

# Set this to the same number as BT_MAX_CONN
config BT_MAX_PAIRED
    default 6

endif

# ZMK Studio Support
CONFIG_ZMK_STUDIO=y
CONFIG_ZMK_SETTINGS_SHELL=y
```

## config/west.yml
```yaml
manifest:
  remotes:
    - name: zmkfirmware
      url-base: https://github.com/zmkfirmware
    - name: janpfischer
      url-base: https://github.com/janpfischer
  projects:
    - name: zmk
      remote: zmkfirmware
      revision: v0.3.0
      import: app/west.yml
    - name: zmk-dongle-screen
      remote: janpfischer
      revision: 0.1.2
  self:
    path: config
```
